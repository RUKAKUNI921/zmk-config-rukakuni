## boards/shields/kanamori_kibo/Kconfig.defconfig
```kconfig
if SHIELD_KANAMORI_KIBO_LEFT

config ZMK_KEYBOARD_NAME
    default "kanamori-kibo"

config ZMK_SPLIT_ROLE_CENTRAL
    default y

endif # SHIELD_KANAMORI_KIBO_LEFT

if SHIELD_KANAMORI_KIBO_LEFT || SHIELD_KANAMORI_KIBO_RIGHT

config ZMK_SPLIT
    default y

endif # SHIELD_KANAMORI_KIBO_LEFT || SHIELD_KANAMORI_KIBO_RIGHT
```

## boards/shields/kanamori_kibo/Kconfig.shield
```kconfig
config SHIELD_KANAMORI_KIBO_LEFT
    def_bool $(shields_list_contains,kanamori_kibo_left)

config SHIELD_KANAMORI_KIBO_RIGHT
    def_bool $(shields_list_contains,kanamori_kibo_right)
```
